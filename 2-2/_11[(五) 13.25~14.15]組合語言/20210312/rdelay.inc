; delay routine dedicate to Simulator
; using R0, R1, R2, R3
;
DELAY100US:
	PUSH	ACC
	MOV	A,R1
	PUSH	ACC
	MOV	R1,#44
	DJNZ	R1,$
	POP	ACC
	MOV	R1,A
	POP	ACC
	RET
;
DELAY1MS:
	PUSH	ACC
	MOV	A,R1
	PUSH	ACC
	MOV	R1,#255
	DJNZ	R1,$
	MOV	R1,#236
	DJNZ	R1,$
	POP	ACC
	MOV	R1,A
	POP	ACC
	RET
;
DELAY10MS:
	PUSH	ACC
	MOV	A,R0
	PUSH	ACC
	MOV	A,R1
	PUSH	ACC
	MOV	R0,#19
DELAY10ms_1:
	MOV	R1,#255
	DJNZ	R1,$
	DJNZ	R0,DELAY10ms_1
	MOV	R1,#113
	DJNZ	R1,$
	NOP
	POP	ACC
	MOV	R1,A
	POP	ACC
	MOV	R0,A
	POP	ACC
	RET
;
DELAY100MS:
	PUSH	ACC
	MOV	A,R0
	PUSH	ACC
	MOV	A,R1
	PUSH	ACC
	MOV	R0,#194
DELAY100ms_1:
	MOV	R1,#255
	DJNZ	R1,$
	DJNZ	R0,DELAY100ms_1
	POP	ACC
	MOV	R1,A
	POP	ACC
	MOV	R0,A
	POP	ACC
        RET
;
DELAY1S:
	PUSH	ACC
	MOV	A,R2
	PUSH	ACC
	MOV	R2,#10
DELAY1s_1:
	LCALL	DELAY100MS
	DJNZ	R2,DELAY1s_1
	POP	ACC
	MOV	R2,A
	POP	ACC
	RET
;
DELAY10S:
	PUSH	ACC
	MOV	A,R2
	PUSH	ACC
	MOV	R2,#100
DELAY10s_1:
	LCALL	DELAY100MS
 	DJNZ	R2,DELAY10s_1
	POP	ACC
	MOV	R2,A
	POP	ACC
	RET
;
DELAY100S:
	PUSH	ACC
	MOV	A,R3
	PUSH	ACC
	MOV	R3,#10
DELAY100s_1:
	LCALL	DELAY10S
	DJNZ	R3,DELAY100s_1
	POP	ACC
	MOV	R2,A
	POP	ACC
	RET
;
DELAY100USP:
	PUSH	ACC
	MOV	A,R1
	PUSH	ACC
	MOV	A, R7
DELAY100usP_1:
	MOV	R1,#44
	DJNZ	R1,$
	DJNZ	ACC,DELAY100usP_1    
	POP	ACC
	MOV	R1,A
	POP	ACC
	RET
;
