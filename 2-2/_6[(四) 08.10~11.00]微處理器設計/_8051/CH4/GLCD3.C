/********GLCD3.C*****繪圖型LCD(直排)實習板***********
*動作：在繪圖型LCD上顯示"歡迎參觀"，往右捲動
********************************************************/
#include "..\AT89X52.H"   //暫存器及組態定義
#include "fontA.h"  
#include "fontC.h"  

sfr    Data=0x80;//P0資料BUS輸出
sbit   DI=0x90;//P10 LCD指令/資料控制輸出,DI=0指令，DI=1資料
sbit   RW=0x91;  //P11 LCD讀取/寫入控制輸出, RW=0寫入，RW=1讀取
sbit   EN=0x92;  //P12 LCD致能輸出,EN=0禁能LCD，EN=1致能LCD
sbit   CS1=0x93; //CS1=1，繪圖型LCD左半部選擇
sbit   CS2=0x94; //CS2=1，繪圖型LCD右半部選擇
/********************************************
*函數名稱:FillHWAN
*功能描述:寫入資料到繪圖型LCD的上或下半部，顯示4個中文字
*輸入參數：*pp
**********************************************/
void FillHWAN(unsigned char code *pp,char xp_start)
{
  char y_addr; //定義LCD顯示Y軸位址
  for(y_addr=0; y_addr < 64; y_addr++) //X軸位址0,32
  {
     GLCD_Cmd(0xb8+xp_start+0); //Y軸位址0,間隔32，分開上下
     GLCD_Cmd(0x40+y_addr); //X頁位址0~7
     GLCD_Data(*pp++);  //以指標方式讀取資料，寫入由左而右2個字
     GLCD_Cmd(0xb8+xp_start+1); //Y軸位址0,間隔32，分開上下
     GLCD_Cmd(0x40+y_addr); //X頁位址0~7
     GLCD_Data(*pp++);  //以指標方式讀取資料，寫入由左而右2個字

   
  }
}
 /********************************************
*函數名稱:主程式
*功能描述:在繪圖型LCD上顯示直排"歡迎參觀"
**********************************************/
main()
{
  char i;      //定義資料計數  
  CS1=CS2=1;	  //開啟繪圖型LCD上下半部控制
  Delay_ms(5);      //等待GLCD開機時間
  GLCD_Cmd(0x3f);   //0011111D，D=1開啟螢幕

  CS1=1; CS2=0;     //開啟繪圖型LCD上半部顯示
  FillHWAN(&fontA[0],0);//以指標方式讀取資料，寫入前4個字型
  CS1=0; CS2=1;	  //開啟繪圖型LCD下半部顯示
  FillHWAN(&fontA[128],0);//以指標方式讀取資料，寫入後4個字型
  
  CS1=1; CS2=0;     //開啟繪圖型LCD上半部顯示
  FillHWAN(&fontC[0],2);//以指標方式讀取資料，寫入前4個字型
  CS1=0; CS2=1;	  //開啟繪圖型LCD下半部顯示
  FillHWAN(&fontC[128],2);//以指標方式讀取資料，寫入後4個字型

  CS1=CS2=1; //開啟繪圖型LCD上下半部控制
   while(1)   //整個畫面往右捲動
   {
     for(i=0; i<64 ;i++) //計數=0~63
     {
      //GLCD_Cmd(0xC0+i);////11xxxxxx+0~63，開始行數=0~63往右移
       Delay_ms(100);
     }
  }
}
/**************************************************
*函數名稱: LCD_wait
*功能描述: LCD等待忙碌旗標BF
****************************************************/
void LCD_wait(void)
{
  unsigned char status;  //定義LCD讀取狀態
  Data=0xff; //P0設定為輸入埠
  do
  {
    DI=0;RW=1;EN=1;	//讀取命令
    status= Data;	//輸入LCD的命令
    EN=0;			//禁能LCD
  }
  while(status & 0x80); //等待忙碌旗標BF=0
}
/*******************************************
*函數名稱: GLCD_Cmd
*功能描述: 寫入命令到繪圖型LCD
*輸入參數：cmd
*********************************************/
void GLCD_Cmd(unsigned char cmd)
{
	Data=cmd;	//輸出命令	
	DI=0;RW=0;EN=1;EN=0; RW=1;//寫入命令
	LCD_wait();	//等待忙碌旗標BF
}
/********************************************
*函數名稱: GLCD_Data
*功能描述: 寫入資料到繪圖型LCD
*輸入參數：dat
*********************************************/
void GLCD_Data(char dat)
{
	Data=dat;  	 //輸出資料
	DI=1;RW=0;EN=1;EN=0;RW=1;//寫入資料
	LCD_wait();	//等待忙碌旗標BF
}