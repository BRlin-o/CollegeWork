/********** RYG3.c ******************************
*動作：令LED輸出紅黃綠燈變化，當KEY=0時黃燈互閃
***********************************************/
#include "..\AT89X52.H"   //暫存器及組態定義
sfr  LED=0x80; //P0為LED輸出
sbit KEY=0xA0; //按鍵開關由P20輸入
char code light[]=   //紅黃綠燈的變化資料
{0x21,0x01,0x21,0x01,0x21,0x01,0x21,0x11,
 0x0C,0x08,0x0C,0x08,0x0C,0x08,0x0C,0x0A};

char code time[] =   //每一個變化的時間
{30,1,1,1,1,1,1,4,30,1,1,1,1,1,1,4};

main()
{
  char i;  //資料計數
  while(1) //永久循環執行
  {
   if(KEY==1)//KEY==1，紅黃綠燈動作
     {
      for (i=0;i<16;i++) //設定0~15個變化
      {
        if(KEY==0) break;//若當KEY=0時，跳出迴圈，黃燈互閃
        LED=~light[i];  //紅黃綠燈資料反相輸出
        Delay_ms(time[i]*10);//將每一個變化的時間送到延時函數
      }
    }
   else
     {
       if(KEY==1) break;//若當KEY=1時，跳出迴圈，紅黃綠燈動作
       LED=~0x10;  Delay_ms(10);     //黃燈互閃
       LED=~0x02; Delay_ms(10);
     }
   }
}