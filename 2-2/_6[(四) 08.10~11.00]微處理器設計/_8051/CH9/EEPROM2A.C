 /********** EEPROM2A.C *********************************
*動作：讀取16-bit陣列資料寫入EEPROM，再重覆讀取到LED輸出
*接腳：CS=P33,SK=P05,DI=P06,DO=P07,ORG=開路
******************************************************/
#include "..\AT89X52.H"   //暫存器及組態定義
sfr LED=0x80;   //LED由P0輸出
sbit CS=P2 ^7 ;	//EEPROM 93C46接線
sbit SK=P2 ^6 ;
sbit DI=P2 ^5 ;
sbit DO=P2 ^4 ;

uint16 code Table[] 
  ={0x0101,0x0202,0x0404,0x0808,0x1010,0x2020,0x4040,0x8080}; 
 /****************************************************
 函數名稱: Clock
 功能描述:送入93C46串列EEPROM時脈信號
*****************************************************/
void Clock(void)
 {
  SK=1;Delay_ms(1); 
  SK=0;Delay_ms(1);
 }
/*****************************************************
 函數名稱: Write
 功能描述: 送入93C46串列送入OP code及EEPROM位址
 輸入參數：Addr
******************************************************/
void Write(uint8 Addr) //送入OP code(xx)及位址(A5~A0)
{
  uint8 i;   
  for(i=0;i<8;i++)       //bit7 ~A0 
   {
     if(Addr & 0x80) DI=1; //若bit7=1，則DI=1
       else DI= 0;         //若bit7=0，則DI=0
     Clock();              //串列時脈，位址輸入EEPROM
     Addr= Addr << 1;      //位址左移
   }
}
/*************************************************
 函數名稱: Read_16
 功能描述: 讀取93C46串列EEPROM資料
 輸入參數：Addr
**************************************************/
uint16 Read_16(uint8 Addr)
 {
  uint8 i;
  uint16 ch=0; //16-bit資料
  CS=1;        //開啟EEPROM晶片  
  DI=1; Clock();   //啟始位元
  Write(Addr+0x80);//送入OP code(10)及位址      
  for(i=0;i<16;i++)//讀取16-bit資料 
   {
     Clock();      //串列資料由DO輸出
     ch=ch << 1;   //資料位元左移
     if(DO==1)  ch=ch | 0x01; //若DO=1，則ch資料位元=1
    }
  CS=0;       //關閉EEPROM晶片 
  return ch;  //將16-bit資料送回主程式
}
/********************************************
 函數名稱:Send_16
 功能描述:送入位址及16-bit資料
 輸入參數：Addr,ch
*********************************************/
void Send_16(uint8 Addr,uint16 ch)	//送入位址及16-bit資料
{ 
  CS=1;     //開啟EEPROM晶片
  DI=1;Clock() ;   //啟始位元    
  Write(Addr+0x40); //送入OP code(01)及位址  
  Write(ch>>8);//寫入高位元組資料
  Write(ch); //寫入低位元組資料
  Delay_ms(1);     //等待寫入完畢
  CS=0;            //關閉EEPROM晶片
}
/****************************************************
 函數名稱: EWEN
 功能描述: 93C46串列EEPROM寫入及清除致能
****************************************************/
void EWEN(void)   //EEPROM寫入及清除致能
{
  CS=1;          //開啟EEPROM晶片
  DI=1; Clock(); //啟始位元    
  Write(0x30);    //送入OP code(00)及寫入致能位址  
  CS=0;          //關閉EEPROM晶片
}
/************************************************
 函數名稱: EWDS
 功能描述: 93C46串列EEPROM寫入及清除禁能
***********************************************/
void EWDS(void)  //EEPROM寫入及清除禁能
{
  CS=1;         //開啟EEPROM晶片
  DI=1;Clock(); //啟始位元	    
  Write(0x00);   //送入OP code(00)及//寫入禁能位址
  CS=0;         //關閉EEPROM晶片
 } 
/*************************************************
 函數名稱: ERAL
 功能描述: 93C46串列EEPROM清除全部記憶體
**************************************************/
void ERAL(void) //EEPROM清除全部記憶體
{
  CS=1;        //開啟EEPROM晶片
  DI=1;Clock();//啟始位元
  Write(0x20);  //送入OP code(00)及清除全部記憶體位址
  CS=0;        //關閉EEPROM晶片
}
//***********************************************/
main()
 {
   uint8  i; 
   uint16 var; //宣告16-bit資料
   CS=0; SK=0; DO=1; DI=1;//EEPROM的接腳啟始電位
   EWEN(); //寫入及清除致能   
   ERAL(); //清除全部記憶體
   for(i=0;i<8;i++) //寫入EEPROM資料
    {
      var=Table[i]; //讀取列表資料
      Send_16(i,var);  //送入位址及16-bit資料
	  LED=(var>>8);    //資料高位元組反相輸出
	  //P1=~var;       //資料低位元組反相輸出
      Delay_ms(200);  //延時
    }
   EWDS();   //寫入及清除禁能
  
   while(1)   //不斷重覆讀取EEPROM的資料
    {  
       for(i=0;i<8;i++) //讀取EEPROM資料
       {
        var=Read_16(i);//讀取EEPROM的16-bit資料
		LED=(var>>8); //資料高位元組反相輸出
	//	P1=~var;        //資料低位元組反相輸出
        Delay_ms(200);  //延時
       }
   }
} 