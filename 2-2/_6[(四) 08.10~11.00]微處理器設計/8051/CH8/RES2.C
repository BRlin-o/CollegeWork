/************* RES2.C ****數位電阻實習***********
*動作：手動控制數位電阻的移動及儲存
*************************************************/
#include "..\AT89X52.H"  //暫存器及組態定義
sbit  CS=P1^0;   //P10為CS，0=數位電阻工作 
sbit  UD=P1^2;   //P12為UD，1=中間抽頭往上，0=中間抽頭往下
sbit  INC=P1^1;  //P11為INC，負緣(1->0)中間抽頭移一格
sbit  UP=P3^2;   //P32控制中間抽頭往上移一格及儲存位置
sbit  Down=P3^3; //P33控制中間抽頭往下移一格及儲存位置

void PULSE(void)  //INC=1->0中間抽頭移一格
{
  INC=1;Delay_ms(1); 
  INC=0;Delay_ms(1);
}
main()  
{
  while(1)  //重覆執行 
   {
    if(UP==0) //檢查是否有按UP鍵
	  {
	    CS=0;UD=1;   //中間抽頭往上移
	    Delay_ms(1); //延時
		  PULSE();     //中間抽頭上移一格
		  while(UP==0);//等待放開UP鍵
		  Delay_ms(1); //防止機械跳動
	    INC=1; CS=1; //儲存中間抽頭移動位置
	  }
	 
	if(Down==0) //檢查是否有按Down鍵
	  {
	    CS=0;UD=0;   //中間抽頭往下移
	    Delay_ms(1); //延時
		  PULSE();     //中間抽頭下移一格
		  while(Down==0);//等待放開Down鍵
		  Delay_ms(1); //防止機械跳動
	    INC=1; CS=1; //儲存中間抽頭移動位置
	  } 
   }
}