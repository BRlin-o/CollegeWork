/*********** STEP2.C ***************************
*動作：將驅動數碼存在陣列資料內，以手動方式控制步進馬達運轉                             
*      P2_0=控制正反轉，1=正轉，0=反轉。
*      P2_1=控制運轉/停止，1=運轉，0=停止
*      P2_2=控制減速，1=不變，0=減速
*      P2_3=控制加速，1=不變，0=加速
*接線：步進馬達輸出：P34=A,P35=B,P36=/A,P37=/B 
***********************************************/
#include "..\AT89X52.H"   //暫存器及組態定義
sfr   LED=0x80;  //LED由P0輸出
sfr   STEP=0xB0; //步進馬達由P3輸出

unsigned char run_Table[]={0x1,0x2,0x4,0x8};//驅動數碼
void main()
{
  char i;     //定義資料計數
  unsigned char speed=10; //定義馬達速度變數初值
  STEP=0x0F;   //步進馬達初值：P34~P37=0000
  while(1) 
   {
     while(P2_1==0);       //若P21=0，停止運轉
	 if(P2_2==0) speed++;  //若P22=0減速
	 if(P2_3==0) speed--;  //若P23=0加速
     if(P2_0==1)           //若P21=1，P20=1，馬達正轉
     {
      if(i>3) i=0;       //若資料計數>3，從0開始
      LED=run_Table[i];     //讀取驅動數碼由LED輸出 
	  STEP=run_Table[i]<<4; //讀取驅動數碼由步進馬達輸出 
      Delay_ms(speed);   //延時時間 
      i++;               //資料計數+1	  
     }
       else              //若P21=1，P20=0，馬達反轉
        {
         if(i<0) i=3;       //若資料計數<0，從3開始   
         LED=run_Table[i];     //讀取驅動數碼由LED輸出 
	     STEP=run_Table[i]<<4; //讀取驅動數碼由步進馬達輸出
         Delay_ms(speed);   //延時時間
         i--;               //資料計數-1       
        }
  }
}