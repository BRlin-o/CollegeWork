/********GLCD2.C*******繪圖型LCD(橫排)實習板範例********
*動作：在繪圖型LCD上顯示"歡迎參觀"，往右上捲動
********************************************************/
#include "..\AT89X52.H"   //暫存器及組態定義//
#include "font_H.h"  //「歡迎參觀」橫排字型檔
sfr    Data=0x80;//P0資料BUS輸出
sbit   DI=0x96;  //P16 LCD指令/資料控制,DI=0指令，DI=1資料
                 //LCD讀取/寫入控制,R/W=GND寫入
sbit   EN=0x97;  //P17 LCD致能輸出,EN=0禁能LCD，EN=1致能LCD
sbit   CS1=0x94; //CS1=1，繪圖型LCD左半部選擇
sbit   CS2=0x95; //CS2=1，繪圖型LCD右半部選擇
/********************************************
*函數名稱:FillHWAN
*功能描述:寫入資料到繪圖型LCD的左或右半部，顯示4個中文字
*輸入參數：pidx
**********************************************/
void FillHWAN(unsigned int pidx)
{
  char i;      //定義計數變數
  char x_page; //定義LCD顯示X頁位址
  char y_addr; //定義LCD顯示Y軸位址
  for(y_addr=0; y_addr<64; y_addr+=32) //Y軸位址0,間隔32，分開左右
  {
    for(x_page=0; x_page< 8; x_page++) //X頁位址0~7
	{
	 GLCD_Cmd(0xb8+x_page); //設定X頁位址
	 GLCD_Cmd(0x40+y_addr); //設定Y軸位址
	 for(i=0; i< 32 ;i++)   //寫入32筆資料
	   GLCD_Data(font_H[pidx++]);//寫入由上而下2個字
    }
  }
}
/********************************************
*函數名稱:主程式
*功能描述:在繪圖型LCD上顯示橫排"歡迎參觀"
**********************************************/
main()
{
  unsigned char i;  //定義計數變數
  CS1=CS2=1;	    //開啟繪圖型LCD左右半部控制
  Delay_ms(5);      //等待GLCD開機時間
  GLCD_Cmd(0x3f);   //0011111D，D=1開啟螢幕

  CS1=1; CS2=0;     //開啟繪圖型LCD左半部顯示
  FillHWAN(0);      //寫入前4個字型
  CS1=0; CS2=1;    //開啟繪圖型LCD右半部顯示
  FillHWAN(128*4); //寫入後4個字型
  
  CS1=CS2=1; //開啟繪圖型LCD左右半部控制
  while(1)   //整個畫面往上捲動
     {
      for(i=0; i<64 ;i++) //計數=0~63
	{
	  GLCD_Cmd(0xC0+i);////11xxxxxx+0~63，開始行數=0~63往上移
  	  Delay_ms(100);
	}
  }
}
/*******************************************
*函數名稱: GLCD_Cmd
*功能描述: 寫入命令到繪圖型LCD
*輸入參數：cmd
*********************************************/
void GLCD_Cmd(unsigned char cmd)
{
	Data=cmd;	//輸出命令	
	DI=0;EN=1;	//寫入命令
    Delay_ms(10);EN=0; 	//等待寫入完成	
}
/********************************************
*函數名稱: GLCD_Data
*功能描述: 寫入資料到繪圖型LCD
*輸入參數：dat
*********************************************/
void GLCD_Data(char dat)
{
	Data=dat;  	 //輸出資料
	DI=1;EN=1;	//寫入資料
    Delay_ms(10);EN=0; 	//等待寫入完成	
}