/************* RES1.C ****數位電阻實習*************
*動作：控制數位電阻輸出三角波，並在LED顯示移動位置                   
*************************************************/
#include "..\AT89X52.H"  //暫存器及組態定義
sfr   LED=0x80; //P0為LED輸出
sbit  CS=P1^0;  //P10為CS，0=數位電阻工作 
sbit  UD=P1^2;  //P12為UD，1=中間抽頭往上，0=中間抽頭往下
sbit  INC=P1^1; //P11為INC，負緣(1->0)中間抽頭移一格

void PULSE(void)  //INC=1->0中間抽頭移一格
{
  INC=1;Delay_ms(1); 
  INC=0;Delay_ms(1);
}
main()  
{
  int i; //中間抽頭移動計數	   
  CS=0;UD=0;           //中間抽頭往下移
  for(i=255; i>=0; i--) //確保中間抽頭移到最底下
  {
    PULSE(); 	  //中間抽頭移一格
	LED=i;        //在LED顯示移動位置
  }
  
  while(1)         //重覆執行 
  {
    UD=1;      //中間抽頭往上移
	for(i=0; i<=255; i++)//輸出電壓上升 
     {
	  LED=i;        //在LED顯示移動位置	 
	  PULSE(); 	    //中間抽頭移一格
	  Delay_ms(100);//延時
	 } 
    
	UD=0;      //中間抽頭往下移
	for(i=255; i>=0; i--)//輸出電壓下降 
     {
	  LED=i;        //在LED顯示移動位置	 
	  PULSE(); 	    //中間抽頭移一格
	  Delay_ms(100);//延時
	 } 
  }
}