/********** 5_3.c *****************************
*動作：主程式P0遞加，
*       在INT0(P32)腳輸入負緣觸發時，P0閃爍50次
*       在INT1(P33)腳輸入負緣觸發時，P0遞加50次
*       且INT1外部中斷優先
***********************************************/
#include "..\AT89X52.H"   //暫存器及組態定義
main()    //主程式
{
  unsigned char  j=0;      //定義變數=0
  EA=1;          //致能整體中斷
  EX0=1; EX1=1; //致能外部INT0中斷及INT1中斷
  IT0=1; IT1=1; //設定INT0腳及INT1腳負緣觸發中斷
  PX1=1;        //設定INT1中斷優先
  while(1)      //不斷循環
   {
     P0=j;    //變數由P0輸出
	 Delay_ms(100);
     j++;
  }
}
/*********************************/
void EX0_int(void) interrupt 0   //INT0中斷函數0
{
  char i;
  int dly;
  for(i=0;i<50;i++) //閃爍計數
   {
     P0=0x00;for(dly=0;dly<20000;dly++); 
     P0=0xff;for(dly=0;dly<20000;dly++);
   }
}
/*********************************************/
void EX1_int(void) interrupt 2   //INT1中斷函數2
{
  char i; 
  int dly;     
  for(i=0;i<50;i++)   //遞加計數
   {
     P0=i; for(dly=0;dly<20000;dly++);
   }
}